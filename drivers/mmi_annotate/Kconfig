## drivers/mmi_annotate/Kconfig
```kconfig
config MMI_ANNOTATE
	default n
	bool "Motorola Mobility Info"
	help
	  Provide mechanism to export MSM various info.
```

## drivers/mmi_info/Kconfig
```kconfig
config MMI_INFO
	default n
	bool "Motorola Mobility Info"
	help
	  Provide mechanism to export MSM various info.

config MMI_BOOT_INFO
	default n
	bool "Motorola Mobility Boot Info"
	help
	  Provide mechanism to export MSM boot info.
```
