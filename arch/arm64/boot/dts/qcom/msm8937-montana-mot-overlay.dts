/* Copyright (c) 2019, Wiktor Strzębała
 *
 * This program is free software; you can redistribute it and/or modify
 * it under the terms of the GNU General Public License version 2 and
 * only version 2 as published by the Free Software Foundation.
 *
 * This program is distributed in the hope that it will be useful,
 * but WITHOUT ANY WARRANTY; without even the implied warranty of
 * MERCHANTABILITY or FITNESS FOR A PARTICULAR PURPOSE.  See the
 * GNU General Public License for more details.
 */

/dts-v1/;

#include <dt-bindings/clock/msm-clocks-8952.h>

#include "msm8937-montana.dtsi"

/ {

	model = "montana";
	compatible = "qcom,msm8937-montana", "qcom,msm8937-moto", "qcom,msm8937";
	qcom,board-id = <0x43 0x8000>;
	qcom,msm-id = <294 0x0>;

};
